## arch/arm64/Kconfig
```kconfig
config ARM64
	def_bool y
	help
	  ARM 64-bit (AArch64) support.

config 64BIT
	def_bool y

choice
	prompt"Platform selection"
	default ARCH_BCM2835
	help
	  Platform selection.

config ARCH_BCM2835
	bool "Broadcom BCM2835 family"
	help
	This enables support for the Broadcom BCM2837 and BCM2711 SoC.
	These SoCs are used in the Raspberry Pi 3 and 4 devices.

config ARCH_QEMU_AARCH64
	bool "QEMU_AARCH64"
	help
	This enables support for the QEMU AARCH64
endchoice

choice
	prompt "Board selection"
	default BOARD_PI4B

config BOARD_PI3B
	bool "Raspberry 3B"

config BOARD_PI4B
	bool "Raspberry 4B"
endchoice

choice
	prompt "Uart for Pi"
	default PI_MINI_UART
	depends on ARCH_BCM2835

config PI_MINI_UART
	bool "mini_uart"

config PI_PL_UART
	bool "pl_uart"
endchoice


#source "kernel/Kconfig"
source "init/Kconfig"
```

## init/Kconfig
```kconfig
#
# For a description of the syntax of this configuration file,
# see scripts/kbuild/config-language.txt.
#

choice
	prompt "Init Config"
	default aaaBOARD_PI3B

config INIT_CONFIG
	bool "Init Config"

config NONE
	bool "NONE"
endchoice

source "lab/Kconfig"
```

## lab/Kconfig
```kconfig
#
# For a description of the syntax of this configuration file,
# see scripts/kbuild/config-language.txt.
#

menu "Lab Practice"

source "lab/rlk/Kconfig" 

config Lab_opennna
	bool "Lab_OpenNNA"
endmenu
```

## lab/rlk/Kconfig
```kconfig
#
# For a description of the syntax of this configuration file,
# see scripts/kbuild/config-language.txt.
#

choice
	prompt "Lab rlk choice"
	default LAB_NONE

config LAB_NONE
	bool "Lab_None"

config LAB3_1
	bool "Lab3_1"

config LAB3_2
	bool "Lab3_2"

config LAB3_3
	bool "Lab3_3"

config LAB3_4
	bool "Lab3_4"

config LAB3_5
	bool "Lab3_5"

config LAB3_6
	bool "Lab3_6"
    
config LAB4_1
	bool "Lab4_1"

config LAB4_2
	bool "Lab4_2"

config LAB4_3
	bool "Lab4_3"

config LAB4_4
	bool "Lab4_4"

config LAB4_5
	bool "Lab4_5"

config LAB5_1
	bool "Lab5_1"
    
config LAB5_2
	bool "Lab5_2"

config LAB5_3
	bool "Lab5_3"

config LAB6_1
	bool "Lab6_1"

config LAB6_2
	bool "Lab6_2"

config LAB6_3
	bool "Lab6_3"

config LAB6_4
	bool "Lab6_4"
endchoice
```
